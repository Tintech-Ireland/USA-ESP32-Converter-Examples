## examples/ble_nus_tester/sdkconfig.defaults
```kconfig
# Console on the native USB-Serial-JTAG port (flash + monitor over one cable).
CONFIG_ESP_CONSOLE_USB_SERIAL_JTAG=y

# Bluetooth: NimBLE host in the central role.
CONFIG_BT_ENABLED=y
CONFIG_BT_NIMBLE_ENABLED=y
CONFIG_BT_NIMBLE_ROLE_CENTRAL=y
CONFIG_BT_NIMBLE_ROLE_OBSERVER=y
CONFIG_PARTITION_TABLE_SINGLE_APP_LARGE=y
```

## examples/bt_to_rs485/sdkconfig.defaults
```kconfig
# Console on the native USB-Serial-JTAG port (flash + monitor over one cable).
CONFIG_ESP_CONSOLE_USB_SERIAL_JTAG=y

# Bluetooth: NimBLE host (BLE-only, lightweight - suits the ESP32-C3).
CONFIG_BT_ENABLED=y
CONFIG_BT_NIMBLE_ENABLED=y

# BLE app image is large; give it a bigger factory partition than the 1 MB default.
CONFIG_PARTITION_TABLE_SINGLE_APP_LARGE=y
```

## examples/can_to_can/sdkconfig.defaults
```kconfig
# Route the console (stdout + ESP_LOG) to the native USB-Serial-JTAG port, so the
# board can be flashed AND monitored over its single USB connection.
# The CAN example uses the TWAI peripheral (GPIO7/GPIO6), so the console choice
# does not conflict with the protocol under test.
CONFIG_ESP_CONSOLE_USB_SERIAL_JTAG=y
```

## examples/i2c_master_slave/master/sdkconfig.defaults
```kconfig
# Route the console (stdout + ESP_LOG) to the native USB-Serial-JTAG port, so the
# board can be flashed AND monitored over its single USB connection.
# The I2C link uses GPIO0/GPIO1 (spare header), so the console choice does not conflict.
CONFIG_ESP_CONSOLE_USB_SERIAL_JTAG=y
```

## examples/modbus_rtu_slave/sdkconfig.defaults
```kconfig
# Console on the native USB-Serial-JTAG port (flash + monitor over one cable).
# The slave uses UART1 (RS485), so the console choice does not conflict.
CONFIG_ESP_CONSOLE_USB_SERIAL_JTAG=y
```

## examples/modbus_tcp_client/sdkconfig.defaults
```kconfig
# Console on the native USB-Serial-JTAG port (flash + monitor over one cable).
CONFIG_ESP_CONSOLE_USB_SERIAL_JTAG=y
```

## examples/rs232_to_rs232/sdkconfig.defaults
```kconfig
# Route the console (stdout + ESP_LOG) to the native USB-Serial-JTAG port, so the
# board can be flashed AND monitored over its single USB connection.
# The RS232 example uses UART1 (GPIO5/GPIO4) for the link, so the console choice
# does not conflict with the protocol under test.
CONFIG_ESP_CONSOLE_USB_SERIAL_JTAG=y
```

## examples/rs485_to_rs485/sdkconfig.defaults
```kconfig
# Route the console (stdout + ESP_LOG) to the native USB-Serial-JTAG port, so the
# board can be flashed AND monitored over its single USB connection.
# The RS485 example uses UART1 (GPIO9/GPIO8) for the link, so the console choice
# does not conflict with the protocol under test.
CONFIG_ESP_CONSOLE_USB_SERIAL_JTAG=y
```

## examples/spi_master_slave/slave/sdkconfig.defaults
```kconfig
# Route the console (stdout + ESP_LOG) to the native USB-Serial-JTAG port, so the
# board can be flashed AND monitored over its single USB connection.
# The SPI link uses GPIO2/5/7/10, so the console choice does not conflict.
CONFIG_ESP_CONSOLE_USB_SERIAL_JTAG=y
```

## examples/wifi_to_can/sdkconfig.defaults
```kconfig
# Console on the native USB-Serial-JTAG port (flash + monitor over one cable).
# The bridge uses the TWAI (CAN) peripheral, so the console choice does not conflict.
CONFIG_ESP_CONSOLE_USB_SERIAL_JTAG=y
```
